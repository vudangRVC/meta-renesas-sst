## meta-rzg2l/conf/machine/rzpi.conf
```bitbake
#@TYPE: Machine
#@NAME: RZ SBC machine
#@DESCRIPTION: RZ/G2L SBC platform

SOC_FAMILY = "r9a07g044l"
require conf/machine/include/rzg2l-common.inc
require conf/machine/include/cip-core.inc

DEFAULTTUNE ?= "cortexa55"

TUNE_CONF ?= "conf/machine/include/tune-cortexa55.inc"
require ${TUNE_CONF}

PREFERRED_PROVIDER_virtual/kernel="linux-renesas"

UBOOT_CONFIG ??= "rzpi"
UBOOT_CONFIG[rzpi] = "rzpi_defconfig"

# flash writer
EXTRA_IMAGEDEPENDS += " flash-writer"

# Support board with PMIC. Default:yes.
# With this option enabled, build both bin files for PMIC board and Concrete board.
PMIC_SUPPORT ?= "1"

# Supported devicetree
KERNEL_DEVICETREE = " \
	renesas/rzpi.dtb \
"
```
